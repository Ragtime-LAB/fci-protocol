## zephyr/Kconfig
```kconfig
menuconfig FCI_PROTOCOL
    bool "FCI protocol library"
    depends on CPP
    help
      Enable the shared FCI protocol library and the vendored
      RPL-based packet definitions it depends on.
```
